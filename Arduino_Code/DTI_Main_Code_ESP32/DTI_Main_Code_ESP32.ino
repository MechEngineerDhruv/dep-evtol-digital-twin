// Include necessary libraries for I2C communication, sensors, and JSON formatting
#include <Wire.h>
#include <Adafruit_INA219.h>
#include <HX711_ADC.h>
#include <ArduinoJson.h>

// Define the ESP32 GPIO pins used for the HX711 Load Cell Amplifier
const int HX711_dout = 4;
const int HX711_sck = 5; 

// Define the ESP32 GPIO pin used to send the PWM signal to the 30A ESC
const int ESC_PIN = 18;  

// Initialize the Load Cell and INA219 sensor objects
HX711_ADC LoadCell(HX711_dout, HX711_sck);
Adafruit_INA219 ina219;

// Global variable to track the current PWM signal (1000 = motor off, 2000 = full throttle)
int currentPWM = 1000; 

void setup() {
  // Initialize serial communication at a high baud rate for fast data transfer
  Serial.begin(115200); 
  delay(10);
  
  // Initialize the INA219 power sensor. Halt the program if the sensor is not found.
  if (!ina219.begin()) {
    Serial.println("Failed to find INA219 chip");
    while (1) { delay(10); }
  }

  // Initialize and wake up the HX711 load cell amplifier
  LoadCell.begin();
  LoadCell.start(2000); // Allow 2000ms for the tare operation to stabilize
  
  // Set the calibration factor. You must replace '1.0' with the specific number 
  // generated by your HX711 calibration script for your exact 5kg load cell.
  LoadCell.setCalFactor(1.0); 
  
  // NEW V3.x.x PWM API: Attach the pin directly with 50Hz frequency and 16-bit resolution
  ledcAttach(ESC_PIN, 50, 16); 
  
  // Send the minimum throttle signal (1000us) to "arm" the ESC. 
  // Target the ESC_PIN instead of channel 0
  ledcWrite(ESC_PIN, 3276); 
  delay(3000); // Wait 3 seconds to allow the ESC to initialize and beep
}

void loop() {
  // 1. ACQUIRE PHYSICAL TELEMETRY
  // Update the load cell reading and store the measured thrust in grams
  LoadCell.update();
  float thrust_g = LoadCell.getData();
  
  // Read the bus voltage (the voltage of the main power supply reaching the ESC)
  float voltage_V = ina219.getBusVoltage_V();
  
  // 2. APPLY HARDWARE MODIFICATION SCALING
  // The standard library assumes a 0.1-ohm resistor. Because you installed a 
  // 0.01-ohm resistor, the physical voltage drop is 10x smaller. 
  // We read the raw value, multiply by 10, and convert from milliamps to Amps.
  float current_mA_raw = ina219.getCurrent_mA();
  float current_A_actual = (current_mA_raw * 10.0) / 1000.0; 
  
  // Calculate total power draw in Watts (Power = Voltage x Current)
  float power_W_actual = voltage_V * current_A_actual;

  // 3. PACKAGE DATA FOR DIGITAL TWIN (UPLINK)
  // Create a JSON document to cleanly package the telemetry
  StaticJsonDocument<200> doc;
  doc["time"] = millis();                // Timetamp for transient response tracking
  doc["thrust_g"] = thrust_g;            // Aerodynamic lift
  doc["voltage"] = voltage_V;            // Electrical stability
  doc["current_A"] = current_A_actual;   // Corrected electrical load
  doc["power_W"] = power_W_actual;       // Total power consumption
  doc["pwm"] = currentPWM;               // Current command state

  // Serialize the JSON document and push it out over the USB serial cable
  serializeJson(doc, Serial);
  Serial.println();

  // 4. PROCESS INCOMING COMMANDS (DOWNLINK)
  // Check if the Python dashboard has sent a new throttle command
  if (Serial.available() > 0) {
    String command = Serial.readStringUntil('\n'); // Read the incoming string
    int newPWM = command.toInt(); // Convert string to integer
    
    // Validate the command to ensure it falls within the safe operating range
    if (newPWM >= 1000 && newPWM <= 2000) {
      currentPWM = newPWM;
      
      // Map the 1000-2000us standard RC pulse to the ESP32's 16-bit timer range (3276 to 6553)
      int dutyCycle = map(currentPWM, 1000, 2000, 3276, 6553);
      
      // NEW V3.x.x PWM API: Write to the pin instead of channel 0
      ledcWrite(ESC_PIN, dutyCycle); 
    }
  }
  
  // Small delay to prevent serial buffer overflow (runs at ~50Hz)
  delay(20); 
}